## dts/bindings/behaviors/zmk,behavior-os-key-one-param.yaml
```yaml
compatible: "zmk,behavior-os-key-one-param"
include: [os-key-base.yaml, zero_param.yaml]
```

## dts/bindings/behaviors/zmk,behavior-os-key-two-param.yaml
```yaml
compatible: "zmk,behavior-os-key-two-param"
include: [os-key-base.yaml, two_param.yaml]
```

## dts/bindings/behaviors/zmk,behavior-os-selector.yaml
```yaml
description: |
  OS Selector Behavior

  Selects the current operating system so that os-key behaviors dispatch
  to the correct per-OS binding.

  Example usage in a keymap behaviors block:

    os_sel: os_selector {
        compatible = "zmk,behavior-os-selector";
        #binding-cells = <1>;
    };

  Then bind it with the OS constant as the parameter:

    &os_sel OS_UNS
    &os_sel OS_LIN
    &os_sel OS_WIN
    &os_sel OS_MAC
    &os_sel OS_IOS

  (requires #include <dt-bindings/zmk/oskey.h> in the keymap file)

compatible: "zmk,behavior-os-selector"

include: one_param.yaml

properties:
  default-os:
    type: int
    required: false
    description: select the default os
    enum:
      - 0  # unsure
      - 1  # linux
      - 2  # windows
      - 3  # macos
      - 4  # ios
```
