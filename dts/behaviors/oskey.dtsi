/*
 * Copyright (c) 2026 mentaldesk
 * SPDX-License-Identifier: MIT
 *
 * Common OS-aware navigation and editing behaviors for oskey.
 *
 * Include in your keymap with:
 *   #include <behaviors/oskey.dtsi>
 *
 * Requires CONFIG_ZMK_BEHAVIOR_OS_KEY=y (enabled automatically when the
 * oskey module is present and any os-key behavior is used).
 *
 */

#include <zephyr/sys/util_macro.h>
#include <dt-bindings/zmk/keys.h>

#define OSKEY(name, uns, lin, win, mac, ios)        \
  name: name {                                      \
    compatible = "zmk,behavior-os-key";             \
    #binding-cells = <0>;                           \
    bindings = <uns>                                \
      , <COND_CODE_0(IS_EMPTY(lin), (lin), (uns))>  \
      , <COND_CODE_0(IS_EMPTY(win), (win), (uns))>  \
      , <COND_CODE_0(IS_EMPTY(mac), (mac), (uns))>  \
      , <COND_CODE_0(IS_EMPTY(ios), (ios), (uns))>  \
    ;                                               \
  };

/ {
    behaviors {

        /* ── OS selector ────────────────────────────────────────────── */

        os_sel: os_selector {
            compatible = "zmk,behavior-os-selector";
            #binding-cells = <1>;
        };

        /* ── Commands ─────────────────────────────────────────────── */

        // Only MacOS is changed here
        // bhv name    , Default   ,,, MacOS     ,
        OSKEY(ok_cut   , &kp LC(X) ,,, &kp LG(X) , )
        OSKEY(ok_copy  , &kp LC(C) ,,, &kp LG(C) , )
        OSKEY(ok_paste , &kp LC(V) ,,, &kp LG(V) , )
        OSKEY(ok_undo  , &kp LC(Z) ,,, &kp LG(Z) , )

        // bhv name    , Default   , Linux         ,, MacOS         ,
        OSKEY(ok_redo  , &kp LC(Y) , &kp LS(LC(Z)) ,, &kp LS(LG(Z)) , )

        // behavior name      , Default       ,,, MacOS         ,
        OSKEY(ok_sel_all      , &kp LC(A)     ,,, &kp LG(A)     , )
        OSKEY(ok_find         , &kp LC(F)     ,,, &kp LG(F)     , )
        OSKEY(ok_find_replace , &kp LC(H)     ,,, &kp LG(H)     , )
        OSKEY(ok_bold         , &kp LC(B)     ,,, &kp LG(B)     , )
        OSKEY(ok_italic       , &kp LC(I)     ,,, &kp LG(I)     , )
        OSKEY(ok_underline    , &kp LC(U)     ,,, &kp LG(U)     , )
        OSKEY(ok_new_win      , &kp LC(N)     ,,, &kp LG(N)     , )
        OSKEY(ok_new_tab      , &kp LC(T)     ,,, &kp LG(T)     , )
        OSKEY(ok_close        , &kp LC(W)     ,,, &kp LG(W)     , )
        OSKEY(ok_quit         , &kp LA(F4)    ,,, &kp LG(Q)     , )
        OSKEY(ok_reopen_tab   , &kp LS(LC(T)) ,,, &kp LS(LG(T)) , )
        OSKEY(ok_open         , &kp LC(O)     ,,, &kp LG(O)     , )
        OSKEY(ok_save         , &kp LC(S)     ,,, &kp LG(S)     , )
        OSKEY(ok_save_as      , &kp LS(LC(S)) ,,, &kp LS(LG(S)) , )
        OSKEY(ok_print        , &kp LC(P)     ,,, &kp LG(P)     , )
        OSKEY(ok_zoom_in      , &kp LC(EQUAL) ,,, &kp LG(EQUAL) , )
        OSKEY(ok_zoom_out     , &kp LC(MINUS) ,,, &kp LG(MINUS) , )
        OSKEY(ok_zoom_reset   , &kp LC(N0)    ,,, &kp LG(N0)    , )

        /* ── Navigation ─────────────────────────────────────────────── */
        // behavior name    , Default       ,,, MacOS         ,
        OSKEY(ok_prev_word  , &kp LC(LEFT)  ,,, &kp LA(LEFT)  , )
        OSKEY(ok_next_word  , &kp LC(RIGHT) ,,, &kp LA(RIGHT) , )
        OSKEY(ok_line_start , &kp HOME      ,,, &kp LG(LEFT)  , )
        OSKEY(ok_line_end   , &kp END       ,,, &kp LG(RIGHT) , )
        OSKEY(ok_doc_start  , &kp LC(HOME)  ,,, &kp LG(UP)    , )
        OSKEY(ok_doc_end    , &kp LC(END)   ,,, &kp LG(DOWN)  , )

        /* ── Selection (Shift + Navigation) ─────────────────────────── */
        // behavior name       , Default           ,,, MacOS             ,
        OSKEY(ok_sel_prev_word , &kp LS(LC(LEFT))  ,,, &kp LS(LA(LEFT))  , )
        OSKEY(ok_sel_next_word , &kp LS(LC(RIGHT)) ,,, &kp LS(LA(RIGHT)) , )
        OSKEY(ok_sel_line_start, &kp LS(HOME)      ,,, &kp LS(LG(LEFT))  , )
        OSKEY(ok_sel_line_end  , &kp LS(END)       ,,, &kp LS(LG(RIGHT)) , )
        OSKEY(ok_sel_doc_start , &kp LS(LC(HOME))  ,,, &kp LS(LG(UP))    , )
        OSKEY(ok_sel_doc_end   , &kp LS(LC(END))   ,,, &kp LS(LG(DOWN))  , )

        /* ── Window management ───────────────────────────────────────── */
        /* Linux shortcuts are DE-specific; override in your keymap.     */

        // Only Windows is changed here
        OSKEY(ok_next_app , &kp LG(TAB)     ,, &kp LA(TAB)     ,, )
        OSKEY(ok_prev_app , &kp LS(LG(TAB)) ,, &kp LS(LA(TAB)) ,, )

        // behavior name      ,       , Linux         , Windows         , MacOS           ,
        OSKEY(ok_next_tab     , &none , &kp LC(PG_DN) , &kp LC(RBRC)    , &kp LG(RBRC)    , )
        OSKEY(ok_prev_tab     , &none , &kp LC(PG_UP) , &kp LC(LBRC)    , &kp LG(LBRC)    , )
        OSKEY(ok_mission_ctrl , &none , &kp LGUI      , &kp LG(TAB)     , &kp LC(UP)      , )
        OSKEY(ok_force_quit   , &none , &kp LC(ESC)   , &kp LS(LC(ESC)) , &kp LA(LG(ESC)) , )

        // Only MacOS is changed here
        OSKEY(ok_desktop, &kp LG(D) ,,, &kp LG(LC(D)) , )
        OSKEY(ok_lock   , &kp LG(L) ,,, &kp LG(LC(Q)) , )

        ok_ltm: os_layer_mod {
            compatible = "zmk,behavior-os-layer-mod";
            #binding-cells = <2>;
            /*
             * Hold: activates <layer> and holds the OS app-switch modifier,
             *   keeping the switcher menu open while held.
             * Tap: sends <keycode> normally.
             * Release: dismisses the switcher menu and deactivates the layer.
             *
             * Usage:  &ok_ltm APP_SWITCH_LAYER G
             *
             * Override mods in your keymap to use different modifiers.
             */
            tapping-term-ms = <200>;
            /*              Win           Mac           Lin  */
            bindings = <&kp LALT>, <&kp LGUI>, <&kp LGUI>;
        };
    };
};
